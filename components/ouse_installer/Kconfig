## components/ouse_installer/Kconfig
```kconfig
menu "Ouse development tools"
    config OUSE_DEVICE_DEBUG
        bool "Serial device control and on-device tests"
        default y
        help
            Enables explicit DBG commands on the existing wired OPK1 service.
            No network listener or background input polling is added.
endmenu
```

## examples/brookesia-minimal/sdkconfig.defaults
```kconfig
CONFIG_IDF_TARGET="esp32p4"
CONFIG_ESPTOOLPY_FLASHSIZE_16MB=y
CONFIG_PARTITION_TABLE_CUSTOM=y
CONFIG_PARTITION_TABLE_CUSTOM_FILENAME="partitions.csv"
CONFIG_SPIRAM=y
CONFIG_SPIRAM_SPEED_200M=y
# Brookesia workers use PSRAM stacks and perform Flash/NVS/LittleFS operations.
# Keep both instruction/rodata relocation enabled so Flash operations do not
# disable the cache backing those stacks.
CONFIG_SPIRAM_XIP_FROM_PSRAM=y
CONFIG_SPIRAM_FETCH_INSTRUCTIONS=y
CONFIG_SPIRAM_RODATA=y
CONFIG_LV_USE_FS_MEMFS=y
CONFIG_LV_FS_MEMFS_LETTER=77
CONFIG_LV_FREETYPE_USE_LVGL_PORT=y
CONFIG_FREERTOS_TASK_CREATE_ALLOW_EXT_MEM=y
CONFIG_HEAP_POISONING_LIGHT=y
CONFIG_COMPILER_OPTIMIZATION_PERF=y
CONFIG_FREERTOS_HZ=1000
CONFIG_ESP_MAIN_TASK_STACK_SIZE=4096
CONFIG_ESP_CONSOLE_UART_DEFAULT=y
CONFIG_ESP_CONSOLE_UART_BAUDRATE=115200
CONFIG_BROOKESIA_SERVICE_USB_TRANSPORT_UART=y
CONFIG_BROOKESIA_SERVICE_USB_UART_PORT=0
CONFIG_BROOKESIA_HAL_ADAPTOR_ENABLE_STORAGE_DEVICE=y
CONFIG_BROOKESIA_HAL_ADAPTOR_STORAGE_ENABLE_FILE_SYSTEM_IMPL=y
CONFIG_BROOKESIA_HAL_ADAPTOR_STORAGE_FILE_SYSTEM_ENABLE_LITTLEFS=y
CONFIG_BROOKESIA_HAL_ADAPTOR_STORAGE_FILE_SYSTEM_LITTLEFS_FORMAT_IF_MOUNT_FAILED=n
CONFIG_BROOKESIA_HAL_ADAPTOR_STORAGE_ENABLE_KEY_VALUE_IMPL=y
CONFIG_BROOKESIA_HAL_ADAPTOR_ENABLE_DISPLAY_DEVICE=n
CONFIG_BROOKESIA_HAL_ADAPTOR_ENABLE_VIDEO_DEVICE=n
CONFIG_BROOKESIA_HAL_ADAPTOR_ENABLE_POWER_DEVICE=n
CONFIG_BROOKESIA_SERVICE_DISPLAY_ENABLE_AUTO_REGISTER=y
CONFIG_BROOKESIA_SERVICE_STORAGE_ENABLE_AUTO_REGISTER=y
CONFIG_LV_CONF_MINIMAL=y
CONFIG_LV_USE_CLIB_MALLOC=y
CONFIG_LV_USE_CLIB_STRING=y
CONFIG_LV_USE_CLIB_SPRINTF=y
CONFIG_LV_USE_FREETYPE=y
CONFIG_LV_FREETYPE_USE_LVGL_PORT=y
CONFIG_LV_USE_FS_MEMFS=y
CONFIG_LV_FS_MEMFS_LETTER=77
CONFIG_LV_CACHE_DEF_SIZE=1024000
CONFIG_LV_IMAGE_HEADER_CACHE_DEF_CNT=32
CONFIG_ESP_LVGL_ADAPTER_ENABLE_FREETYPE=y
CONFIG_ESP_LVGL_ADAPTER_ENABLE_DECODER=y
CONFIG_ESP_LVGL_ADAPTER_ENABLE_FS=y
CONFIG_LV_FS_STDIO_LETTER=65
CONFIG_LV_FS_POSIX_LETTER=65
CONFIG_LV_FS_DEFAULT_DRIVER_LETTER=65
CONFIG_LV_USE_LODEPNG=y
CONFIG_LV_TXT_ENC_UTF8=y
CONFIG_LV_TXT_ENC_ASCII=n
# OusePocket system, custom BSP audio, C6 Wi-Fi and BLE
CONFIG_ESP_PANIC_HANDLER_IRAM=y
CONFIG_ESP_SYSTEM_PANIC_PRINT_REBOOT=y
CONFIG_ESP_SYSTEM_PANIC_PRINT_HALT=n
CONFIG_ESP_SYSTEM_PANIC_SILENT_REBOOT=n
CONFIG_ESP_SYSTEM_PANIC_GDBSTUB=n
CONFIG_ESP_COREDUMP_ENABLE_TO_UART=y
CONFIG_ESP_COREDUMP_ENABLE_TO_FLASH=n
CONFIG_ESP_COREDUMP_ENABLE_TO_NONE=n
CONFIG_ESP_COREDUMP_CAPTURE_DRAM=y
CONFIG_ESP_COREDUMP_STACK_SIZE=4096
CONFIG_ESP_COREDUMP_MAX_TASKS_NUM=64
CONFIG_ESP_COREDUMP_UART_DELAY=0
CONFIG_ESP_COREDUMP_DECODE_DISABLE=y
CONFIG_ESP_COREDUMP_DECODE_INFO=n
CONFIG_FREERTOS_GENERATE_RUN_TIME_STATS=y
CONFIG_FREERTOS_USE_TRACE_FACILITY=y
CONFIG_FREERTOS_USE_STATS_FORMATTING_FUNCTIONS=y
CONFIG_FREERTOS_RUN_TIME_STATS_USING_ESP_TIMER=y
CONFIG_FREERTOS_RUN_TIME_STATS_USING_CPU_CLK=n
CONFIG_FREERTOS_RUN_TIME_COUNTER_TYPE_U64=y
CONFIG_FREERTOS_RUN_TIME_COUNTER_TYPE_U32=n
CONFIG_BROOKESIA_SERVICE_USB_ENABLE_AUTO_REGISTER=y
CONFIG_BROOKESIA_SYSTEM_CORE_ENABLE_USB_BRIDGE=y
CONFIG_SPIRAM_MALLOC_ALWAYSINTERNAL=0
CONFIG_SPIRAM_MALLOC_RESERVE_INTERNAL=131072
CONFIG_ESP_HOSTED_DFLT_TASK_FROM_SPIRAM=y
CONFIG_BROOKESIA_SERVICE_MANAGER_WORKER_STACK_IN_EXT=n
CONFIG_BROOKESIA_UTILS_THREAD_CONFIG_STACK_IN_EXT=n
CONFIG_BROOKESIA_SERVICE_MANAGER_SECONDARY_SCHEDULER_ENABLE=y
CONFIG_LV_USE_SNAPSHOT=y
CONFIG_BROOKESIA_HAL_ADAPTOR_ENABLE_SYSTEM_DEVICE=y
CONFIG_BROOKESIA_HAL_ADAPTOR_SYSTEM_ENABLE_RESTART_IMPL=y
CONFIG_BROOKESIA_HAL_ADAPTOR_SYSTEM_ENABLE_BOARD_INFO_IMPL=n
CONFIG_BROOKESIA_HAL_ADAPTOR_SYSTEM_ENABLE_OTA_UPDATER_IMPL=n
CONFIG_BROOKESIA_HAL_ADAPTOR_ENABLE_AUDIO_DEVICE=n
CONFIG_BROOKESIA_SERVICE_AUDIO_ENABLE_AUTO_REGISTER=y
CONFIG_BROOKESIA_SERVICE_AUDIO_PLAYBACK_VOLUME_DEFAULT=40
CONFIG_BROOKESIA_HAL_ADAPTOR_ENABLE_WIFI_DEVICE=y
CONFIG_BROOKESIA_SERVICE_WIFI_ENABLE_AUTO_REGISTER=n
CONFIG_BROOKESIA_HAL_ADAPTOR_ENABLE_NETWORK_DEVICE=y
CONFIG_BROOKESIA_HAL_ADAPTOR_NETWORK_ENABLE_SNTP_CLIENT_IMPL=y
CONFIG_BROOKESIA_SERVICE_SNTP_ENABLE_AUTO_REGISTER=n
CONFIG_ESP_SYSTEM_EVENT_TASK_STACK_SIZE=4096
CONFIG_ESP_WIFI_REMOTE_ENABLED=y
CONFIG_ESP_WIFI_REMOTE_LIBRARY_HOSTED=y
CONFIG_SLAVE_IDF_TARGET_ESP32C6=y
CONFIG_ESP_HOSTED_SDIO_HOST_INTERFACE=y
CONFIG_ESP_HOSTED_SDIO_SLOT_1=y
CONFIG_ESP_HOSTED_SDIO_SLOT_0=n
CONFIG_ESP_HOSTED_SDIO_4_BIT_BUS=y
CONFIG_ESP_HOSTED_SDIO_CLOCK_FREQ_KHZ=25000
CONFIG_ESP_HOSTED_PRIV_SDIO_PIN_CLK_SLOT_1=18
CONFIG_ESP_HOSTED_PRIV_SDIO_PIN_CMD_SLOT_1=19
CONFIG_ESP_HOSTED_PRIV_SDIO_PIN_D0_SLOT_1=14
CONFIG_ESP_HOSTED_PRIV_SDIO_PIN_D1_4BIT_BUS_SLOT_1=15
CONFIG_ESP_HOSTED_PRIV_SDIO_PIN_D2_4BIT_BUS_SLOT_1=16
CONFIG_ESP_HOSTED_PRIV_SDIO_PIN_D3_4BIT_BUS_SLOT_1=17
CONFIG_ESP_HOSTED_SDIO_GPIO_RESET_SLAVE=54
CONFIG_ESP_HOSTED_HOST_RESTART_NO_COMMUNICATION_WITH_SLAVE=n
CONFIG_BROOKESIA_HAL_ADAPTOR_ENABLE_BLE_DEVICE=n
CONFIG_BROOKESIA_HAL_ADAPTOR_ENABLE_BT_DEVICE=n
CONFIG_BROOKESIA_SERVICE_BLE_ENABLE_AUTO_REGISTER=n
CONFIG_BT_ENABLED=n
CONFIG_BT_NIMBLE_ENABLED=n
CONFIG_BT_BLUEDROID_ENABLED=n
CONFIG_BT_CONTROLLER_DISABLED=y
CONFIG_BT_CONTROLLER_ENABLED=n
CONFIG_BT_NIMBLE_TRANSPORT_UART=n
CONFIG_BT_NIMBLE_ROLE_PERIPHERAL=n
CONFIG_BT_NIMBLE_ROLE_CENTRAL=n
CONFIG_BT_NIMBLE_GATT_SERVER=n
CONFIG_ESP_HOSTED_ENABLE_BT_NIMBLE=n
CONFIG_ESP_HOSTED_NIMBLE_HCI_VHCI=n
```

## sdkconfig.defaults
```kconfig
CONFIG_IDF_TARGET="esp32p4"
CONFIG_ESP32P4_REV_MIN_301=y
CONFIG_ESP_DEFAULT_CPU_FREQ_MHZ_400=y
CONFIG_ESPTOOLPY_FLASHSIZE_16MB=y
CONFIG_PARTITION_TABLE_CUSTOM=y
CONFIG_PARTITION_TABLE_CUSTOM_FILENAME="partitions.csv"
CONFIG_SPIRAM=y
CONFIG_SPIRAM_ALLOW_BSS_SEG_EXTERNAL_MEMORY=y
CONFIG_SPIRAM_SPEED_200M=y
CONFIG_SPIRAM_XIP_FROM_PSRAM=y
CONFIG_SPIRAM_FETCH_INSTRUCTIONS=y
CONFIG_SPIRAM_RODATA=y
CONFIG_SPIRAM_MALLOC_ALWAYSINTERNAL=0
CONFIG_SPIRAM_MALLOC_RESERVE_INTERNAL=131072
CONFIG_HEAP_POISONING_LIGHT=y
CONFIG_COMPILER_OPTIMIZATION_PERF=y
CONFIG_FREERTOS_HZ=1000
CONFIG_ESP_MAIN_TASK_STACK_SIZE=8192
CONFIG_ESP_CONSOLE_UART_CUSTOM=y
CONFIG_ESP_CONSOLE_UART_CUSTOM_NUM_0=y
CONFIG_ESP_CONSOLE_UART_TX_GPIO=37
CONFIG_ESP_CONSOLE_UART_RX_GPIO=38
CONFIG_ESP_CONSOLE_UART_BAUDRATE=921600
CONFIG_ESPTOOLPY_MONITOR_BAUD=921600
# Use only the adapter's UI task, without LVGL background draw threads.
CONFIG_LV_CONF_MINIMAL=y
CONFIG_LV_COLOR_DEPTH_16=y
CONFIG_LV_DEF_REFR_PERIOD=33
CONFIG_LV_USE_CLIB_MALLOC=y
CONFIG_LV_USE_CLIB_STRING=y
CONFIG_LV_USE_CLIB_SPRINTF=y
CONFIG_LV_OS_NONE=y
CONFIG_LV_USE_DRAW_SW=y
CONFIG_LV_DRAW_SW_DRAW_UNIT_CNT=1
CONFIG_LV_USE_LABEL=y
CONFIG_LV_USE_BUTTON=y
CONFIG_LV_USE_SLIDER=y
CONFIG_LV_USE_BAR=y
CONFIG_LV_USE_ARC=y
CONFIG_LV_USE_CHECKBOX=y
CONFIG_LV_USE_DROPDOWN=y
CONFIG_LV_USE_SPINNER=y
CONFIG_LV_FONT_MONTSERRAT_16=y
CONFIG_LV_FONT_MONTSERRAT_24=y
CONFIG_LV_FONT_DEFAULT_MONTSERRAT_16=y
CONFIG_LV_TXT_ENC_UTF8=y
CONFIG_LV_CACHE_DEF_SIZE=0
CONFIG_LV_IMAGE_HEADER_CACHE_DEF_CNT=0
CONFIG_ESP_LVGL_ADAPTER_ENABLE_FREETYPE=n
CONFIG_ESP_LVGL_ADAPTER_ENABLE_DECODER=n
CONFIG_ESP_LVGL_ADAPTER_ENABLE_FS=n
CONFIG_ESP_LVGL_ADAPTER_ENABLE_FPS_STATS=n
CONFIG_ESP_LVGL_ADAPTER_LVGL_THREAD_STACK_IN_PSRAM=n

CONFIG_LV_USE_IMAGE=y
CONFIG_LV_USE_SNAPSHOT=y
CONFIG_LV_DRAW_SW_COMPLEX=y
CONFIG_LV_USE_FLEX=y

CONFIG_LV_USE_SWITCH=y

# P4 -> C6 over the board SDIO bus. Desktop starts before manual Hosted init.
CONFIG_ESP_WIFI_REMOTE_ENABLED=y
CONFIG_ESP_WIFI_REMOTE_LIBRARY_HOSTED=y
CONFIG_SLAVE_IDF_TARGET_ESP32C6=y
CONFIG_ESP_HOSTED_SDIO_HOST_INTERFACE=y
CONFIG_ESP_HOSTED_SDIO_SLOT_1=y
CONFIG_ESP_HOSTED_SDIO_SLOT_0=n
CONFIG_ESP_HOSTED_SDIO_4_BIT_BUS=y
CONFIG_ESP_HOSTED_SDIO_CLOCK_FREQ_KHZ=25000
CONFIG_ESP_HOSTED_PRIV_SDIO_PIN_CLK_SLOT_1=18
CONFIG_ESP_HOSTED_PRIV_SDIO_PIN_CMD_SLOT_1=19
CONFIG_ESP_HOSTED_PRIV_SDIO_PIN_D0_SLOT_1=14
CONFIG_ESP_HOSTED_PRIV_SDIO_PIN_D1_4BIT_BUS_SLOT_1=15
CONFIG_ESP_HOSTED_PRIV_SDIO_PIN_D2_4BIT_BUS_SLOT_1=16
CONFIG_ESP_HOSTED_PRIV_SDIO_PIN_D3_4BIT_BUS_SLOT_1=17
CONFIG_ESP_HOSTED_SDIO_GPIO_RESET_SLAVE=54
CONFIG_ESP_HOSTED_HOST_RESTART_NO_COMMUNICATION_WITH_SLAVE=n
CONFIG_ESP_HOSTED_TRANSPORT_RESTART_ON_FAILURE=n
CONFIG_BT_ENABLED=y
CONFIG_BT_CONTROLLER_DISABLED=y
CONFIG_BT_BLUEDROID_ENABLED=n
CONFIG_BT_NIMBLE_ENABLED=y
CONFIG_BT_NIMBLE_TRANSPORT_UART=n
CONFIG_ESP_HOSTED_ENABLE_BT_NIMBLE=y
CONFIG_ESP_HOSTED_NIMBLE_HCI_VHCI=y
CONFIG_BT_NIMBLE_MEM_ALLOC_MODE_EXTERNAL=y
CONFIG_BT_NIMBLE_CRYPTO_STACK_MBEDTLS=y
CONFIG_BT_NIMBLE_NVS_PERSIST=y
CONFIG_BT_NIMBLE_SM_SC=y
CONFIG_BT_NIMBLE_SM_SC_ONLY=1
CONFIG_BT_NIMBLE_MAX_CONNECTIONS=1
CONFIG_BT_NIMBLE_MAX_BONDS=4
CONFIG_BT_NIMBLE_HOST_TASK_STACK_SIZE=6144
CONFIG_ESP_HOSTED_DFLT_TASK_FROM_SPIRAM=n
CONFIG_LV_USE_TEXTAREA=y
CONFIG_LV_USE_KEYBOARD=y
CONFIG_LV_USE_BUTTONMATRIX=y

CONFIG_LV_FONT_SOURCE_HAN_SANS_SC_14_CJK=y
CONFIG_ESP_PANIC_HANDLER_IRAM=y
CONFIG_ESP_COREDUMP_ENABLE_TO_UART=y
CONFIG_ESP_COREDUMP_ENABLE_TO_FLASH=n
CONFIG_ESP_COREDUMP_ENABLE_TO_NONE=n
CONFIG_ESP_COREDUMP_CAPTURE_DRAM=y
CONFIG_ESP_COREDUMP_STACK_SIZE=4096
CONFIG_ESP_COREDUMP_MAX_TASKS_NUM=64
CONFIG_ESP_COREDUMP_UART_DELAY=0
CONFIG_ESP_COREDUMP_DECODE_DISABLE=y
CONFIG_ESP_COREDUMP_DECODE_INFO=n

# Scheduled-task accounting for QuickJS protection; 64-bit ESP timer avoids 71-minute rollover.
CONFIG_FREERTOS_GENERATE_RUN_TIME_STATS=y
CONFIG_FREERTOS_RUN_TIME_STATS_USING_ESP_TIMER=y
CONFIG_FREERTOS_RUN_TIME_COUNTER_TYPE_U64=y
CONFIG_MBEDTLS_CERTIFICATE_BUNDLE=y
CONFIG_MBEDTLS_CERTIFICATE_BUNDLE_DEFAULT_FULL=y
CONFIG_MBEDTLS_CERTIFICATE_BUNDLE_CROSS_SIGNED_VERIFY=y

# Native P4 OTG HS composite: PCM16 speaker/mic + Windows 11 CDC NCM.
CONFIG_TINYUSB_NET_MODE_NCM=y
CONFIG_TINYUSB_NCM_OUT_NTB_BUFFS_COUNT=2
CONFIG_TINYUSB_NCM_IN_NTB_BUFFS_COUNT=2
CONFIG_TINYUSB_NCM_OUT_NTB_BUFF_MAX_SIZE=2048
CONFIG_TINYUSB_NCM_IN_NTB_BUFF_MAX_SIZE=2048
CONFIG_TINYUSB_DEBUG_LEVEL=0
CONFIG_LWIP_IP_FORWARD=y
CONFIG_LWIP_IPV4_NAPT=y
CONFIG_LWIP_IPV4_NAPT_PORTMAP=n
CONFIG_CAMERA_OV5647=y
CONFIG_CAMERA_OV5647_MIPI_RAW10_1280X960_BINNING_45FPS=y
CONFIG_CAMERA_OV5647_MIPI_DEFAULT_FMT_RAW10_1280X960_BINNING_45FPS=y
CONFIG_ISP_PIPELINE_CONTROLLER_TASK_STACK_USE_PSRAM=y
# CONFIG_ESP_VIDEO_ENABLE_DVP_VIDEO_DEVICE is not set
CONFIG_ESP_VIDEO_ENABLE_ISP_PIPELINE_CONTROLLER=y
CONFIG_VFS_MAX_COUNT=20
CONFIG_ESP_HOSTED_DFLT_TASK_FROM_SPIRAM=y
CONFIG_ESP_HOSTED_SDIO_TX_Q_SIZE=8
CONFIG_ESP_HOSTED_SDIO_RX_Q_SIZE=8
```
